## boards/shields/midnight52/Kconfig.defconfig
```kconfig
if SHIELD_MIDNIGHT52_LEFT || SHIELD_MIDNIGHT52_RIGHT

config ZMK_KEYBOARD_NAME
    default "midnight52"

config ZMK_SPLIT
    default y

endif
```
